## CMakeLists.txt
```
# SPDX-License-Identifier: Apache-2.0

cmake_minimum_required(VERSION 3.20.0)
set(BOARD fk743m5_xih6)
set(BOARD_FLASH_RUNNER jlink)
set(BOARD_DEBUG_RUNNER jlink)
set(BOARD_RUNNER_ARGS_jlink
    "--loader=BankAddr=0x90000000&Loader=CLK@PF10_nCS@PG6_D0@PF8_D1@PF9_D2@PF7_D3@PF6"
    CACHE STRING "Extra J-Link runner args" FORCE)
find_package(Zephyr REQUIRED HINTS $ENV{ZEPHYR_BASE})
find_package(Python3 REQUIRED COMPONENTS Interpreter)

project(cpp LANGUAGES CXX)

FILE(GLOB app_sources src/*.c src/*.cc)
target_sources(app PRIVATE ${app_sources})

# Keep build logs clean: suppress GCC psABI compatibility notes (e.g. from std::format).
target_compile_options(app PRIVATE $<$<COMPILE_LANGUAGE:CXX>:-Wno-psabi>)

# Relocate app code/rodata to external flash (XIP, no copy).
# External flash memory-mapped setup is handled by Zephyr when CONFIG_STM32_MEMMAP=y.
# zephyr_code_relocate(FILES $<TARGET_PROPERTY:app,SOURCES> LOCATION SDRAM1_BSS_NOINIT_DATA)
zephyr_code_relocate(FILES $<TARGET_PROPERTY:app,SOURCES> LOCATION EXTFLASH_TEXT_RODATA NOCOPY)

target_include_directories(app PRIVATE ${CMAKE_SOURCE_DIR}/include)

# The code below locates the git index file for this repository and adds it as a dependency for
# the application VERSION file so that if the repo has a new commit added, even if no files in
# the build have changed, the application version file will be regenerated with the new git commit
find_package(Git QUIET)
if(GIT_FOUND)
  execute_process(
    COMMAND ${GIT_EXECUTABLE} rev-parse --absolute-git-dir
    WORKING_DIRECTORY .
    OUTPUT_VARIABLE application_git_dir
    OUTPUT_STRIP_TRAILING_WHITESPACE
    ERROR_STRIP_TRAILING_WHITESPACE
    ERROR_VARIABLE stderr
    RESULT_VARIABLE return_code
  )
  # If there is an error e.g. it is not a git repo, we just silently ignore it and continue
  # without a dependency, this will be the case with freestanding applications.
  if(NOT return_code)
    if(NOT "${stderr}" STREQUAL "")
      message(WARNING "Application build version git rev-parse warned: ${stderr}")
    endif()

    set_property(TARGET app_version_h PROPERTY APP_VERSION_DEPENDS ${application_git_dir}/index)
  endif()
endif()

# Update VS Code debug settings via workspace setup script.
# Run this after final zephyr.elf is linked (not after app library build).
set(VSCODE_SETUP_SCRIPT ${ZEPHYR_BASE}/../.vscode/setup.py)
if(EXISTS ${VSCODE_SETUP_SCRIPT})
  get_filename_component(VSCODE_ARM_TOOLCHAIN_PATH ${CMAKE_GDB} DIRECTORY)

  set(VSCODE_JLINK_DEVICE "")
  set(VSCODE_JLINK_LOADER "")
  get_property(VSCODE_JLINK_ARGS GLOBAL PROPERTY BOARD_RUNNER_ARGS_jlink)

  foreach(arg IN LISTS VSCODE_JLINK_ARGS)
    if(arg MATCHES "^--device=(.*)$")
      set(VSCODE_JLINK_DEVICE ${CMAKE_MATCH_1})
    elseif(arg MATCHES "^--loader=(.*)$")
      set(VSCODE_JLINK_LOADER ${CMAKE_MATCH_1})
    endif()
  endforeach()

  if(VSCODE_JLINK_LOADER)
    set(VSCODE_JLINK_DEVICE_FULL "${VSCODE_JLINK_DEVICE}?${VSCODE_JLINK_LOADER}")
  else()
    set(VSCODE_JLINK_DEVICE_FULL ${VSCODE_JLINK_DEVICE})
  endif()

  set(VSCODE_SETUP_STAMP ${CMAKE_BINARY_DIR}/.vscode_setup.stamp)
  add_custom_command(
    OUTPUT ${VSCODE_SETUP_STAMP}
    COMMAND ${Python3_EXECUTABLE} ${VSCODE_SETUP_SCRIPT}
      --app-path ${CMAKE_CURRENT_SOURCE_DIR}
      --build-path ${CMAKE_BINARY_DIR}
      --toolchain-path ${VSCODE_ARM_TOOLCHAIN_PATH}
      --gdb-path ${CMAKE_GDB}
      --device ${VSCODE_JLINK_DEVICE_FULL}
      --launch-json ${ZEPHYR_BASE}/../.vscode/launch.json
    COMMAND ${CMAKE_COMMAND} -E touch ${VSCODE_SETUP_STAMP}
    DEPENDS ${CMAKE_BINARY_DIR}/zephyr/zephyr.elf ${VSCODE_SETUP_SCRIPT}
    COMMENT "Run .vscode/setup.py to update launch.json and build symlink"
    VERBATIM
  )
  add_custom_target(vscode_setup_symlink ALL DEPENDS ${VSCODE_SETUP_STAMP})
endif()
```

## Kconfig
```
# SPDX-License-Identifier: Apache-2.0

mainmenu "98-cpp"

# Your application configuration options go here

# Sources Kconfig.zephyr in the Zephyr root directory.
#
# Note: All 'source' statements work relative to the Zephyr root directory (due
# to the $srctree environment variable being set to $ZEPHYR_BASE). If you want
# to 'source' relative to the current Kconfig file instead, use 'rsource' (or a
# path relative to the Zephyr root).
source "Kconfig.zephyr"

menu "My Application Settings"

endmenu
```

## prj.conf
```kconfig
# Debug
CONFIG_DEBUG_OPTIMIZATIONS=y
# CONFIG_SPEED_OPTIMIZATIONS is not set
CONFIG_STM32_ENABLE_DEBUG_SLEEP_STOP=y

# Thread
CONFIG_MAIN_STACK_SIZE=16384

# Cortex
CONFIG_FPU=y

# Memory
CONFIG_FLASH=y
CONFIG_STM32_MEMMAP=y
CONFIG_MEMC=y

# XIP
CONFIG_CODE_DATA_RELOCATION=y
CONFIG_HAVE_CUSTOM_LINKER_SCRIPT=y
CONFIG_CUSTOM_LINKER_SCRIPT="xip.ld"
CONFIG_COVERAGE=n
CONFIG_XIP=y

# C/C++
CONFIG_STD_C23=y
CONFIG_GNU_C_EXTENSIONS=y
CONFIG_CPP=y
CONFIG_CPP_RTTI=y
CONFIG_STD_CPP23=y
CONFIG_REQUIRES_FLOAT_PRINTF=y
CONFIG_REQUIRES_FULL_LIBCPP=y

# Logging
CONFIG_LOG=y
CONFIG_LOG_RUNTIME_FILTERING=y
CONFIG_LOG_MODE_IMMEDIATE=y
# CONFIG_LOG_MODE_DEFERRED is not set
CONFIG_LOG_BACKEND_UART=y
CONFIG_LOG_BACKEND_UART_AUTOSTART=y
CONFIG_LOG_BACKEND_SWO=y
CONFIG_LOG_BACKEND_SWO_FREQ_HZ=50000000

# Bindesc
CONFIG_BINDESC=y
CONFIG_BINDESC_DEFINE=y

# Pripherals
CONFIG_SDHC=y
CONFIG_RTC=y
CONFIG_RTC_ALARM=y
CONFIG_RTC_CALIBRATION=y
CONFIG_GPIO=y
```

## app.overlay
```dts
#include <zephyr/dt-bindings/memory-attr/memory-attr-arm.h>

&ext_memory {
	zephyr,memory-attr = <DT_MEM_ARM(ATTR_MPU_FLASH)>;
};
```

## src/main.cc
```c
#include "00_ref.h"
#include "01_class.h"
#include "02_static.h"
#include "03_constructor.h"
#include "04_destructor.h"
#include "05_inherit.h"
#include "06_virtual.h"
#include "07_pure_virtual.h"
#include "08_create_object.h"
#include "09_explicit_conversion.h"
#include "10_operator_overload.h"
#include "11_this.h"
#include "12_smart_pointer.h"
#include "13_copy_constructor.h"
#include "14_arrow_operator.h"
#include <zephyr/kernel.h>
#include <zephyr/logging/log.h>
#include <iostream>

LOG_MODULE_REGISTER(98_cpp, LOG_LEVEL_INF);

int main()
{
	LOG_INF("Starting C++ examples...");

	ref_entry();
	_01_class::Entry();
	_02_static::Entry();
	_03_constructor::Entry();
	_04_destructor::Entry();
	_05_inherit::Entry();
	_06_virtual::Entry();
	_07_pure_virtual::Entry();
	_08_create_object::Entry();
	_09_explicit_conversion::Entry();
	_10_operator_overload::Entry();
	_11_this::Entry();
	_12_smart_pointer::Entry();
	_13_copy_constructor::Entry();
	_14_arrow_operator::Entry();

	return 0;
}
```

## include/00_ref.h
```c
#ifndef REF_HPP
#define REF_HPP

int ref_entry(void);

#endif /* REF_HPP */
```

## include/01_class.h
```c
#ifndef CLASS_HPP
#define CLASS_HPP

#include <string>

namespace _01_class
{
class Log
{
public:
	enum class LogLevel {
		kDebug,
		kInfo,
		kWarning,
		kError
	};

	void SetLevel(LogLevel level);

	void Debug(const std::string& message);
	void Info(const std::string& message);
	void Warn(const std::string& message);
	void Error(const std::string& message);

private:
	LogLevel level_ = LogLevel::kInfo;
};

int Entry(void);

}

#endif /* CLASS_HPP */
```

## include/01_class.hpp
```c
#ifndef CLASS_HPP
#define CLASS_HPP

#include <string>

namespace _01_class
{
class Log
{
public:
	enum class LogLevel {
		Debug,
		Info,
		Warning,
		Error
	};

	void set_level(LogLevel level);

	void debug(const std::string& message);
	void info(const std::string& message);
	void warn(const std::string& message);
	void error(const std::string& message);

private:
	LogLevel m_level = LogLevel::Info;
};

int entry(void);

}

#endif /* CLASS_HPP */
```

## include/02_static.h
```c
#ifndef STATIC_HPP
#define STATIC_HPP

namespace _02_static
{
int Entry(void);
}

#endif /* STATIC_HPP */
```

## include/02_static.hpp
```c
#ifndef STATIC_HPP
#define STATIC_HPP

namespace _02_static
{
int entry(void);
}

#endif /* STATIC_HPP */
```

## include/03_constructor.h
```c
#ifndef CONSTRUCTOR_HPP
#define CONSTRUCTOR_HPP

namespace _03_constructor
{
int Entry(void);
}

#endif /* CONSTRUCTOR_HPP */
```

## include/03_constructor.hpp
```c
#ifndef CONSTRUCTOR_HPP
#define CONSTRUCTOR_HPP

namespace _03_constructor
{
int entry(void);
}

#endif /* CONSTRUCTOR_HPP */
```

## include/04_destructor.h
```c
#ifndef DESTRUCTOR_HPP
#define DESTRUCTOR_HPP

namespace _04_destructor
{
int Entry(void);
}

#endif /* DESTRUCTOR_HPP */
```

## include/04_destructor.hpp
```c
#ifndef DESTRUCTOR_HPP
#define DESTRUCTOR_HPP

namespace _04_destructor
{
int entry(void);
}

#endif /* DESTRUCTOR_HPP */
```

## include/05_inherit.h
```c
#ifndef INHERIT_HPP
#define INHERIT_HPP

namespace _05_inherit
{
int Entry(void);
}

#endif /* INHERIT_HPP */
```

## include/06_virtual.h
```c
#ifndef VIRTUAL_HPP_
#define VIRTUAL_HPP_

namespace _06_virtual
{
int Entry(void);
}

#endif /* VIRTUAL_HPP_ */
```

## include/07_pure_virtual.h
```c
#ifndef PURE_VIRTUAL_H_
#define PURE_VIRTUAL_H_

namespace _07_pure_virtual
{
int Entry(void);
}

#endif /* PURE_VIRTUAL_H_ */
```
