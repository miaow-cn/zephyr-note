## CMakeLists.txt
```
# SPDX-License-Identifier: Apache-2.0

cmake_minimum_required(VERSION 3.20.0)
set(BOARD fk743m5_xih6)
set(BOARD_FLASH_RUNNER jlink)
set(BOARD_DEBUG_RUNNER jlink)
set(BOARD_RUNNER_ARGS_jlink
    "--loader=BankAddr=0x90000000&Loader=CLK@PF10_nCS@PG6_D0@PF8_D1@PF9_D2@PF7_D3@PF6"
    CACHE STRING "Extra J-Link runner args" FORCE)
find_package(Zephyr REQUIRED HINTS $ENV{ZEPHYR_BASE})
find_package(Python3 REQUIRED COMPONENTS Interpreter)

project(module LANGUAGES C)
target_sources(app PRIVATE ${CMAKE_SOURCE_DIR}/src/main.c)

# The code below locates the git index file for this repository and adds it as a dependency for
# the application VERSION file so that if the repo has a new commit added, even if no files in
# the build have changed, the application version file will be regenerated with the new git commit
find_package(Git QUIET)
if(GIT_FOUND)
  execute_process(
    COMMAND ${GIT_EXECUTABLE} rev-parse --absolute-git-dir
    WORKING_DIRECTORY .
    OUTPUT_VARIABLE application_git_dir
    OUTPUT_STRIP_TRAILING_WHITESPACE
    ERROR_STRIP_TRAILING_WHITESPACE
    ERROR_VARIABLE stderr
    RESULT_VARIABLE return_code
  )
  # If there is an error e.g. it is not a git repo, we just silently ignore it and continue
  # without a dependency, this will be the case with freestanding applications.
  if(NOT return_code)
    if(NOT "${stderr}" STREQUAL "")
      message(WARNING "Application build version git rev-parse warned: ${stderr}")
    endif()

    set_property(TARGET app_version_h PROPERTY APP_VERSION_DEPENDS ${application_git_dir}/index)
  endif()
endif()

# Update VS Code debug settings via workspace setup script.
# Run this after final zephyr.elf is linked (not after app library build).
set(VSCODE_SETUP_SCRIPT ${ZEPHYR_BASE}/../.vscode/setup.py)
if(EXISTS ${VSCODE_SETUP_SCRIPT})
  get_filename_component(VSCODE_ARM_TOOLCHAIN_PATH ${CMAKE_GDB} DIRECTORY)

  set(VSCODE_JLINK_DEVICE "")
  set(VSCODE_JLINK_LOADER "")
  get_property(VSCODE_JLINK_ARGS GLOBAL PROPERTY BOARD_RUNNER_ARGS_jlink)

  foreach(arg IN LISTS VSCODE_JLINK_ARGS)
    if(arg MATCHES "^--device=(.*)$")
      set(VSCODE_JLINK_DEVICE ${CMAKE_MATCH_1})
    elseif(arg MATCHES "^--loader=(.*)$")
      set(VSCODE_JLINK_LOADER ${CMAKE_MATCH_1})
    endif()
  endforeach()

  if(VSCODE_JLINK_LOADER)
    set(VSCODE_JLINK_DEVICE_FULL "${VSCODE_JLINK_DEVICE}?${VSCODE_JLINK_LOADER}")
  else()
    set(VSCODE_JLINK_DEVICE_FULL ${VSCODE_JLINK_DEVICE})
  endif()

  set(VSCODE_SETUP_STAMP ${CMAKE_BINARY_DIR}/.vscode_setup.stamp)
  add_custom_command(
    OUTPUT ${VSCODE_SETUP_STAMP}
    COMMAND ${Python3_EXECUTABLE} ${VSCODE_SETUP_SCRIPT}
      --app-path ${CMAKE_CURRENT_SOURCE_DIR}
      --build-path ${CMAKE_BINARY_DIR}
      --toolchain-path ${VSCODE_ARM_TOOLCHAIN_PATH}
      --gdb-path ${CMAKE_GDB}
      --device ${VSCODE_JLINK_DEVICE_FULL}
      --launch-json ${ZEPHYR_BASE}/../.vscode/launch.json
    COMMAND ${CMAKE_COMMAND} -E touch ${VSCODE_SETUP_STAMP}
    DEPENDS ${CMAKE_BINARY_DIR}/zephyr/zephyr.elf ${VSCODE_SETUP_SCRIPT}
    COMMENT "Run .vscode/setup.py to update launch.json and build symlink"
    VERBATIM
  )
  add_custom_target(vscode_setup_symlink ALL DEPENDS ${VSCODE_SETUP_STAMP})
endif()
```

## Kconfig
```
# SPDX-License-Identifier: Apache-2.0

mainmenu "01-template"

# Your application configuration options go here

# Sources Kconfig.zephyr in the Zephyr root directory.
#
# Note: All 'source' statements work relative to the Zephyr root directory (due
# to the $srctree environment variable being set to $ZEPHYR_BASE). If you want
# to 'source' relative to the current Kconfig file instead, use 'rsource' (or a
# path relative to the Zephyr root).
source "Kconfig.zephyr"

menuconfig MY_LOG
	bool "Use logging service in 02-module"
	default y
	depends on LOG

if MY_LOG

# for logging
module = 02_MODULE
module-str = 02-module
source "subsys/logging/Kconfig.template.log_config"

endif # MY_LOG
```

## prj.conf
```kconfig
CONFIG_STD_C23=y
CONFIG_GNU_C_EXTENSIONS=y
CONFIG_SPEED_OPTIMIZATIONS=y
CONFIG_STM32_ENABLE_DEBUG_SLEEP_STOP=y

CONFIG_FPU=y
CONFIG_GPIO=y

CONFIG_LOG=y
CONFIG_LOG_SPEED=y
CONFIG_LOG_BACKEND_SWO=y
CONFIG_LOG_BUFFER_SIZE=4096
CONFIG_LOG_PROCESS_THREAD_SLEEP_MS=500
CONFIG_LOG_BACKEND_SWO_FREQ_HZ=1000000
CONFIG_LOG_BACKEND_SWO_REF_FREQ_HZ=240000000

# non-random: CONFIG_TEST_RANDOM_GENERATOR
# true-random: CONFIG_ENTROPY_GENERATOR
# CONFIG_TEST_RANDOM_GENERATOR=y
CONFIG_ENTROPY_GENERATOR=y
```

## src/main.c
```c
/*
 * Copyright (c) 2016 Intel Corporation
 *
 * SPDX-License-Identifier: Apache-2.0
 */

#include <stdio.h>
#include <zephyr/kernel.h>
#include <zephyr/random/random.h>
#include <zephyr/logging/log.h>

LOG_MODULE_REGISTER(CONFIG_02_MODULE_LOG_LEVEL, LOG_LEVEL_INF);

/* 1000 msec = 1 sec */
#define SLEEP_TIME_MS   1000

int main(void)
{
	uint64_t rnd;

	while (1) {
		rnd = sys_rand64_get();
		LOG_HEXDUMP_INF(&rnd, sizeof(rnd), "Rnd:");
		LOG_ERR("value=%llu", rnd);
		k_msleep(SLEEP_TIME_MS);
	}
	return 0;
}
```
