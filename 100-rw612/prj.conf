## CMakeLists.txt
```
# SPDX-License-Identifier: Apache-2.0

cmake_minimum_required(VERSION 3.20.0)
set(BOARD frdm_rw612)
set(BOARD_FLASH_RUNNER jlink)
set(BOARD_DEBUG_RUNNER jlink)
# set_property(GLOBAL APPEND PROPERTY BOARD_RUNNER_ARGS_EXPLICIT_jlink "-O=-ip 192.168.50.243")

find_package(Zephyr REQUIRED HINTS $ENV{ZEPHYR_BASE})

project(rw612 LANGUAGES C)
target_sources(app PRIVATE ${CMAKE_SOURCE_DIR}/src/main.c)

# The code below locates the git index file for this repository and adds it as a dependency for
# the application VERSION file so that if the repo has a new commit added, even if no files in
# the build have changed, the application version file will be regenerated with the new git commit
find_package(Git QUIET)
if(GIT_FOUND)
  execute_process(
    COMMAND ${GIT_EXECUTABLE} rev-parse --absolute-git-dir
    WORKING_DIRECTORY .
    OUTPUT_VARIABLE application_git_dir
    OUTPUT_STRIP_TRAILING_WHITESPACE
    ERROR_STRIP_TRAILING_WHITESPACE
    ERROR_VARIABLE stderr
    RESULT_VARIABLE return_code
  )
  # If there is an error e.g. it is not a git repo, we just silently ignore it and continue
  # without a dependency, this will be the case with freestanding applications.
  if(NOT return_code)
    if(NOT "${stderr}" STREQUAL "")
      message(WARNING "Application build version git rev-parse warned: ${stderr}")
    endif()

    set_property(TARGET app_version_h PROPERTY APP_VERSION_DEPENDS ${application_git_dir}/index)
  endif()
endif()

# Update VS Code debug settings via workspace setup script.
# Run this after final zephyr.elf is linked (not after app library build).
set(VSCODE_SETUP_SCRIPT ${ZEPHYR_BASE}/../.vscode/setup.py)
if(EXISTS ${VSCODE_SETUP_SCRIPT})
  get_filename_component(VSCODE_ARM_TOOLCHAIN_PATH ${CMAKE_GDB} DIRECTORY)

  set(VSCODE_JLINK_DEVICE "")
  set(VSCODE_JLINK_LOADER "")
  get_property(VSCODE_JLINK_ARGS GLOBAL PROPERTY BOARD_RUNNER_ARGS_jlink)

  foreach(arg IN LISTS VSCODE_JLINK_ARGS)
    if(arg MATCHES "^--device=(.*)$")
      set(VSCODE_JLINK_DEVICE ${CMAKE_MATCH_1})
    elseif(arg MATCHES "^--loader=(.*)$")
      set(VSCODE_JLINK_LOADER ${CMAKE_MATCH_1})
    endif()
  endforeach()

  if(VSCODE_JLINK_LOADER)
    set(VSCODE_JLINK_DEVICE_FULL "${VSCODE_JLINK_DEVICE}?${VSCODE_JLINK_LOADER}")
  else()
    set(VSCODE_JLINK_DEVICE_FULL ${VSCODE_JLINK_DEVICE})
  endif()

  set(VSCODE_SETUP_STAMP ${CMAKE_BINARY_DIR}/.vscode_setup.stamp)
  add_custom_command(
    OUTPUT ${VSCODE_SETUP_STAMP}
    COMMAND ${Python3_EXECUTABLE} ${VSCODE_SETUP_SCRIPT}
      --app-path ${CMAKE_CURRENT_SOURCE_DIR}
      --build-path ${CMAKE_BINARY_DIR}
      --toolchain-path ${VSCODE_ARM_TOOLCHAIN_PATH}
      --gdb-path ${CMAKE_GDB}
      --device ${VSCODE_JLINK_DEVICE_FULL}
      --launch-json ${ZEPHYR_BASE}/../.vscode/launch.json
    COMMAND ${CMAKE_COMMAND} -E touch ${VSCODE_SETUP_STAMP}
    DEPENDS ${CMAKE_BINARY_DIR}/zephyr/zephyr.elf ${VSCODE_SETUP_SCRIPT}
    COMMENT "Run .vscode/setup.py to update launch.json and build symlink"
    VERBATIM
  )
  add_custom_target(vscode_setup_symlink ALL DEPENDS ${VSCODE_SETUP_STAMP})
endif()
```

## Kconfig
```
# SPDX-License-Identifier: Apache-2.0

mainmenu "100-rw612"

# Your application configuration options go here

# Sources Kconfig.zephyr in the Zephyr root directory.
#
# Note: All 'source' statements work relative to the Zephyr root directory (due
# to the $srctree environment variable being set to $ZEPHYR_BASE). If you want
# to 'source' relative to the current Kconfig file instead, use 'rsource' (or a
# path relative to the Zephyr root).
source "Kconfig.zephyr"

menu "My Application Settings"

endmenu
```

## prj.conf
```kconfig
CONFIG_STD_C23=y
CONFIG_GNU_C_EXTENSIONS=y
CONFIG_SPEED_OPTIMIZATIONS=y
CONFIG_BUILD_OUTPUT_HEX=y
CONFIG_BUILD_OUTPUT_S19=y

CONFIG_GPIO=y

CONFIG_LOG=y
CONFIG_LOG_RUNTIME_FILTERING=y

CONFIG_BINDESC=y
CONFIG_BINDESC_DEFINE=y
CONFIG_BINDESC_DEFINE_VERSION=y
CONFIG_BINDESC_KERNEL_VERSION_STRING=y
CONFIG_BINDESC_KERNEL_VERSION_MAJOR=y
CONFIG_BINDESC_KERNEL_VERSION_MINOR=y
CONFIG_BINDESC_KERNEL_VERSION_PATCHLEVEL=y
CONFIG_BINDESC_KERNEL_VERSION_NUMBER=y
CONFIG_BINDESC_KERNEL_BUILD_VERSION=y
CONFIG_BINDESC_APP_VERSION_STRING=y
CONFIG_BINDESC_APP_VERSION_MAJOR=y
CONFIG_BINDESC_APP_VERSION_MINOR=y
CONFIG_BINDESC_APP_VERSION_PATCHLEVEL=y
CONFIG_BINDESC_APP_VERSION_NUMBER=y
CONFIG_BINDESC_APP_BUILD_VERSION=y
CONFIG_BINDESC_DEFINE_BUILD_TIME=y
CONFIG_BINDESC_BUILD_TIME_YEAR=y
CONFIG_BINDESC_BUILD_TIME_MONTH=y
CONFIG_BINDESC_BUILD_TIME_DAY=y
CONFIG_BINDESC_BUILD_TIME_HOUR=y
CONFIG_BINDESC_BUILD_TIME_MINUTE=y
CONFIG_BINDESC_BUILD_TIME_SECOND=y
CONFIG_BINDESC_BUILD_TIME_UNIX=y
CONFIG_BINDESC_BUILD_DATE_TIME_STRING=y
CONFIG_BINDESC_BUILD_DATE_STRING=y
CONFIG_BINDESC_BUILD_TIME_STRING=y
CONFIG_BINDESC_DEFINE_HOST_INFO=y
CONFIG_BINDESC_HOST_NAME=y
CONFIG_BINDESC_C_COMPILER_NAME=y
CONFIG_BINDESC_C_COMPILER_VERSION=y
CONFIG_BINDESC_CXX_COMPILER_NAME=y
CONFIG_BINDESC_CXX_COMPILER_VERSION=y
CONFIG_BINDESC_READ=y
CONFIG_BINDESC_READ_RAM=y
CONFIG_BINDESC_READ_MEMORY_MAPPED_FLASH=y
CONFIG_BINDESC_READ_FLASH=y
```

## src/main.c
```c
// /*
//  * Copyright (C) 2026, Miaow - All Rights Reserved
//  *
//  * SPDX-License-Identifier: GPL-3.0-or-later
//  */
// #include <stdio.h>
// #include <zephyr/kernel.h>
// #include <zephyr/bindesc.h>
// #include <zephyr/logging/log.h>

// LOG_MODULE_REGISTER(99_playground, LOG_LEVEL_INF);

// BINDESC_STR_DEFINE(my_string, 1, "Hello world!");
// BINDESC_UINT_DEFINE(my_int, 2, 5);
// BINDESC_BYTES_DEFINE(my_bytes, 3, ({1, 2, 3, 4}));

// int main(void)
// {
// 	// /* Builtin descriptors */
// 	// LOG_INF("Zephyr version %s\n\tmajor:minor %u:%u\n\tnumber %u\n\tpatch %u\n\tbuild %s", BINDESC_GET_STR(kernel_version_string),
// 	// 	BINDESC_GET_UINT(kernel_version_major), BINDESC_GET_UINT(kernel_version_minor),
// 	// 	BINDESC_GET_UINT(kernel_version_number), BINDESC_GET_UINT(kernel_version_patchlevel),
// 	// 	BINDESC_GET_STR(kernel_build_version)
// 	// );
// 	// LOG_INF("App version %s\n\tmajor:minor %u:%u\n\tnumber %u\n\tpatch %u\n\tbuild %s", BINDESC_GET_STR(app_version_string),
// 	// 	BINDESC_GET_UINT(app_version_major), BINDESC_GET_UINT(app_version_minor),
// 	// 	BINDESC_GET_UINT(app_version_number), BINDESC_GET_UINT(app_version_patchlevel),
// 	// 	BINDESC_GET_STR(app_build_version)
// 	// );
// 	// LOG_INF("Build time: %s\n\tdate", BINDESC_GET_STR(build_date_time_string));
// 	// LOG_INF("Compiler: %s %s\n", BINDESC_GET_STR(c_compiler_name),
// 	// 	BINDESC_GET_STR(c_compiler_version));

// 	// /* Custom descriptors */
// 	// LOG_INF("my_string: %s\n", BINDESC_GET_STR(my_string));
// 	// LOG_INF("my_int: %d\n", BINDESC_GET_UINT(my_int));
// 	// LOG_INF("my_bytes: ");
// 	// for (size_t i = 0; i < BINDESC_GET_SIZE(my_bytes); i++) {
// 	// 	LOG_INF("%02x ", BINDESC_GET_BYTES(my_bytes)[i]);
// 	// }
// 	// LOG_INF("\n");

// 	printf("Hello World! %s\n", CONFIG_BOARD_TARGET);

// 	return 0;
// }

/*
 * Copyright (c) 2016 Intel Corporation
 *
 * SPDX-License-Identifier: Apache-2.0
 */

#include <stdio.h>
#include <zephyr/kernel.h>
#include <zephyr/drivers/gpio.h>

/* 1000 msec = 1 sec */
#define SLEEP_TIME_MS   1000

/* The devicetree node identifier for the "led0" alias. */
#define LED0_NODE DT_ALIAS(led0)

/*
 * A build error on this line means your board is unsupported.
 * See the sample documentation for information on how to fix this.
 */
static const struct gpio_dt_spec led = GPIO_DT_SPEC_GET(LED0_NODE, gpios);

int main(void)
{
	int ret;
	bool led_state = true;

	if (!gpio_is_ready_dt(&led)) {
		return 0;
	}

	ret = gpio_pin_configure_dt(&led, GPIO_OUTPUT_ACTIVE);
	if (ret < 0) {
		return 0;
	}

	while (1) {
		ret = gpio_pin_toggle_dt(&led);
		if (ret < 0) {
			return 0;
		}

		led_state = !led_state;
		printf("LED state: %s\n", led_state ? "ON" : "OFF");
		k_msleep(SLEEP_TIME_MS);
	}
	return 0;
}
```
